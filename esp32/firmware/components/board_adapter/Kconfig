## esp32/firmware/components/board_adapter/Kconfig
```kconfig
menu "Waveshare 2.06 英寸板级配置"

    config BOARD_PANEL_SH8601
        bool
        default y
        help
            固定使用厂家受管 BSP 的 SH8601 兼容显示路径；产品页物料名 CO5300 由厂家 BSP 内部适配，不向应用暴露未实现的原生选项。

    config BOARD_PANEL_CO5300
        bool
        default n
        help
            保留旧配置符号兼容现有源码；当前不得由 menuconfig 选择未实现的原生 CO5300 路径。

    config BOARD_TOUCH_FT3168
        bool
        default y
        help
            固定使用厂家受管 BSP 的 FT5x06 兼容触摸路径，覆盖本地原理图标注的 FT3168。

    config BOARD_TOUCH_CST9220
        bool
        default n
        help
            保留旧配置符号兼容现有源码；当前不得由 menuconfig 选择未实现的原生 CST9220 路径。

    config BOARD_ENABLE_QMI_DEEP_WAKE
        bool "允许 QMI8658 GPIO21 从 Deep-sleep 唤醒"
        default y
        help
            默认启用 GPIO21 EXT1 运动唤醒；QMI8658 初始使用 40 mg 门限和 4 个 21 Hz 样本消隐。
            量产前必须在原配电池、外壳、手持和携带条件下实测误唤醒率，并按真机数据校准门限。

endmenu
```

## esp32/firmware/components/board_runtime/Kconfig
```kconfig
menu "Waveshare 2.06 板级运行时"

    choice BOARD_RUNTIME_BACKEND
        prompt "板级运行后端"
        default BOARD_RUNTIME_REAL
        help
            REAL 使用厂家 managed BSP 1.0.7 和真实 GPIO；MOCK 不访问硬件，供无板联调。

        config BOARD_RUNTIME_REAL
            bool "真实 Waveshare BSP"

        config BOARD_RUNTIME_MOCK
            bool "纯软件 Mock"
    endchoice

endmenu
```

## esp32/firmware/components/power_manager/Kconfig
```kconfig
menu "健身手柄低功耗配置"

    config POWER_BATTERY_CAPACITY_MAH
        int "电池额定容量（mAh）"
        range 100 5000
        default 400
        help
            当前产品预算使用 400 mAh 电池；更换电池后必须同步修改并重新实测。

    config POWER_ACTIVE_RUNTIME_TARGET_HOURS
        int "训练续航目标（小时）"
        range 1 24
        default 6

    config POWER_DEEP_STANDBY_TARGET_DAYS
        int "深待机目标（天）"
        range 1 30
        default 7

endmenu
```

## esp32/firmware/components/ui/Kconfig
```kconfig
menu "健身手柄界面配置"

    config UI_IDLE_DIM_TIMEOUT_SECONDS
        int "无操作后调暗时间（秒）"
        range 5 120
        default 10
        help
            均衡模式在 10 秒无触摸后把 AMOLED 从 35% 降到 15%。

    config UI_IDLE_SCREEN_OFF_SECONDS
        int "无操作后熄屏时间（秒）"
        range 10 600
        default 30
        help
        熄屏不停止训练、计数或 BLE；触摸和电源键可重新点亮。

endmenu
```
